## conf/layer.conf
```bitbake
# We have a conf and classes directory, append to BBPATH
BBPATH .= ":${LAYERDIR}"

# We have a recipes directory, add to BBFILES
BBFILES += "${LAYERDIR}/recipes*/*/*.bb ${LAYERDIR}/recipes*/*/*.bbappend"

BBFILE_COLLECTIONS += "meta-cl-mitysom"
BBFILE_PATTERN_meta-cl-mitysom := "^${LAYERDIR}/"

LAYERDEPENDS_meta-cl-mitysom = "meta-intel-fpga"
LAYERSERIES_COMPAT_meta-cl-mitysom = "kirkstone"
```

## conf/machine/mitysom5cse.conf
```bitbake
#@TYPE: Machine
#@NAME: mitysom5cse
#@DESCRIPTION: Machine configuration for CriticalLink MitySOM5CSE - Intel Cyclone V SoC

require conf/machine/include/socfpga.inc

#UBOOT_CONFIG = "sd"
#UBOOT_CONFIG[sd] = "socfpga_mitysom5cse-l2-3y8_defconfig"
UBOOT_MACHINE = "socfpga_mitysom5cs-l2-3y8_defconfig"
UBOOT_ENV = "initrd-squashfs-boot"

MACHINE_FEATURES:remove = " 3g alsa bluetooth irda nfc x11 wayland wifi"
MACHINE_EXTRA_RRECOMMENDS = " kernel-modules"
VIRTUAL-RUNTIME_dev_manager = "busybox-mdev"

PREFERRED_PROVIDER_virtual/bootloader = "u-boot-socfpga-cl"
KMACHINE = "cyclone5"
KERNEL_IMAGETYPE = "zImage"

# Default kernel devicetrees
KERNEL_DEVICETREE = "\
			socfpga_mitysom5cse_l23y8_empty.dtb \
			"

SERIAL_CONSOLES ?= "115200;ttyS0"

SPL_BINARY = "u-boot-with-spl.sfp"

IMAGE_BOOT_FILES ?= " \
	${KERNEL_DEVICETREE} \
	${KERNEL_IMAGETYPE} \
	"

IMAGE_FSTYPES ="wic"
```

## conf/machine/mitysoma10s.conf
```bitbake
#@TYPE: Machine
#@NAME: Intel SoCFPGA Arria10
#@DESCRIPTION: Machine configuration for the Arria 10 SoCFPGA

require conf/machine/include/socfpga.inc
require conf/machine/include/ubifs.inc

# SPL_BINARY = "u-boot-with-spl.sfp"
UBOOT_ENV = "initrd-squashfs-boot"
SPL_BINARY = "spl/u-boot-splx4.sfp"
UBOOT_BINARY = "u-boot.img"

UBOOT_CONFIG ??= "mitysom-a10s-dsc"
UBOOT_CONFIG[arria10-socdk] = "socfpga_arria10_defconfig"
UBOOT_CONFIG[arria10-socdk-nand] = "socfpga_arria10_nand_defconfig"
UBOOT_CONFIG[arria10-socdk-qspi] = "socfpga_arria10_qspi_defconfig"
UBOOT_CONFIG[mitysom-a10s-dsc] = "socfpga_mitysom_a10s_dsc_defconfig"

MACHINE_FEATURES:remove = " 3g alsa bluetooth irda nfc x11 wayland wifi"
MACHINE_EXTRA_RRECOMMENDS = " kernel-modules"
VIRTUAL-RUNTIME_dev_manager = "busybox-mdev"

PREFERRED_PROVIDER_virtual/bootloader = "u-boot-socfpga"
PREFERRED_PROVIDER_virtual/kernel = "linux-socfpga"
PREFERRED_VERSION_linux-socfpga-lts = "6.1%"
PREFERRED_VERSION_u-boot-socfpga = "v2021.04%"

KMACHINE = "arria10"

# Default kernel devicetrees
KERNEL_DEVICETREE ?= "\
			mitysom_a10s_devkit.dtb \
			socfpga_arria10_socdk_sdmmc.dtb \
			socfpga_arria10_socdk_qspi.dtb \
			socfpga_arria10_socdk_nand.dtb \
			"


SERIAL_CONSOLES ?= "115200;ttyS0"

IMAGE_BOOT_FILES ?= " \
	${KERNEL_DEVICETREE} \
	${KERNEL_IMAGETYPE} \
	${UBOOT_BINARY} \ 
    "

IMAGE_FSTYPES = "wic"
```

## wic/sdimage-mitysom5cse.wks
```
# short-description: Create an SD card image for the CL MitySOM 5CSE (Cyclone 5 SoC)
# long-description: Create an SD card image for the CL MitySOM 5CSE (Cyclone 5 SoC)
# UBootEnv (environment variables) are in the first partition (fixed offset right after 
# MBR), u-Boot binary is located in the partition with type 0xA2, and the actual boot files 
# which are loaded by u-boot are located in the third partition (VFAT)

part --source rawcopy --sourceparams="file=u-boot-initrd-env.scr" --ondisk mmcblk --fixed-size 64k
part --source rawcopy --sourceparams="file=u-boot-with-spl.sfp" --ondisk mmcblk --system-id=a2 --align 1024 --fixed-size 10M
part --source bootimg-partition --ondisk mmcblk --fstype=vfat --label boot --active --align 4 --size 256
part --ondisk mmcblk --fstype=ext4 --label persistent --align 4 --size 128M
```
